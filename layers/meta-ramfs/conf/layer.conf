## layers/meta-ramfs/conf/layer.conf
```bitbake
# We have a conf and classes directory, add to BBPATH
BBPATH .= ":${LAYERDIR}"

# We have recipes-* directories, add to BBFILES
BBFILES += "${LAYERDIR}/recipes-*/*/*.bb \
            ${LAYERDIR}/recipes-*/*/*.bbappend"

BBFILE_COLLECTIONS += "meta-ramfs"
BBFILE_PATTERN_meta-ramfs = "^${LAYERDIR}/"
BBFILE_PRIORITY_meta-ramfs = "6"

LAYERDEPENDS_meta-ramfs = "core"
LAYERSERIES_COMPAT_meta-ramfs = "scarthgap"
```

## layers/meta-ramfs/recipes-core/images/custom.wks
```
# short-description: Custom image with data partition using all remaining space
# long-description: Creates a disk image with rootfs and data partition using all remaining space
part /boot --source bootimg-efi --sourceparams="loader=grub-efi" --ondisk sda --label boot --active --size=128M --align 1024
part / --source rootfs --ondisk sda --fstype=ext4 --label root --size=1G --align 1024
part /data --ondisk sda --fstype=ext4 --label data --size=2G --align 1024

bootloader --ptable gpt --timeout=5 --append="rootfstype=ext4 console=ttyS0,115200 console=tty0"
```
